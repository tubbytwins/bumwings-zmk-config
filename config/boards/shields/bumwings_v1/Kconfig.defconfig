## config/boards/shields/bumwings_v1/Kconfig.defconfig
```kconfig
# Copyright (c) 2020 The ZMK Contributors
# and (c) 2022 tubbytwins (Matthew A. Schnoor)
# SPDX-License-Identifier: MIT

if SHIELD_BUMWINGS_V1

config ZMK_KEYBOARD_NAME
    default "BumWings V1"

endif
```

## config/boards/shields/bumwings_v1/Kconfig.shield
```kconfig
# Copyright (c) 2020 The ZMK Contributors
# and (c) 2022 tubbytwins (Matthew A. Schnoor)
# SPDX-License-Identifier: MIT

config SHIELD_BUMWINGS_V1
    def_bool $(shields_list_contains,bumwings_v1)
```
